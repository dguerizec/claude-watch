## sdkconfig.defaults
```kconfig
# Serial flasher
CONFIG_ESPTOOLPY_FLASHSIZE_8MB=y
CONFIG_ESPTOOLPY_FLASHFREQ_80M=y
CONFIG_ESPTOOLPY_FLASHMODE_QIO=y

# FreeRTOS
CONFIG_FREERTOS_HZ=1000

# ESP32-S3 specific
CONFIG_ESP_DEFAULT_CPU_FREQ_240=y

# Log level
CONFIG_LOG_DEFAULT_LEVEL_INFO=y

# Custom partition table
CONFIG_PARTITION_TABLE_CUSTOM=y
CONFIG_PARTITION_TABLE_CUSTOM_FILENAME="partitions.csv"

# Main task stack (WiFi + HTTP need more)
CONFIG_ESP_MAIN_TASK_STACK_SIZE=8192

# Disable WiFi driver's own NVS usage (we manage credentials ourselves)
CONFIG_ESP_WIFI_NVS_ENABLED=n

# Mitigate SPI timing race conditions on shared bus (espressif/esp-idf#17860)
CONFIG_SPI_MASTER_IN_IRAM=y

# FAT: enable long file names (stored on heap)
CONFIG_FATFS_LFN_HEAP=y
CONFIG_FATFS_MAX_LFN=63
```
